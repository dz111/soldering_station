#pragma once

#include "tw.h"
#include "utils.h"

#define WIDTH 132
#define HEIGHT 64
#define PAGES HEIGHT/8

#define MAX_ITER 10

volatile uint8_t oled_buf[WIDTH * HEIGHT / 8];
const uint16_t _oled_bufsiz = sizeof(oled_buf) / sizeof(*oled_buf);

const uint8_t Font1612[11][32] PROGMEM = 
{
  {0x00,0x00,0x3F,0xFC,0x3F,0xFC,0x30,0x0C,0x30,0x0C,0x30,0x0C,0x30,0x0C,0x30,0x0C,
  0x30,0x0C,0x30,0x0C,0x30,0x0C,0x30,0x0C,0x30,0x0C,0x3F,0xFC,0x3F,0xFC,0x00,0x00},/*"0",0*/
  {0x00,0x00,0x00,0x00,0x00,0x00,0x00,0x00,0x00,0x00,0x00,0x00,0x00,0x00,0x30,0x00,
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  0x18,0x30,0x00,0x00,0x00,0x00,0x00,0x00,0x00,0x00,0x00,0x00,0x00,0x00,0x00,0x00},/*":",10*/
};

const uint8_t Font1206[95][12] PROGMEM = {
    {0x00,0x00,0x00,0x00,0x00,0x00,0x00,0x00,0x00,0x00,0x00,0x00},/*" ",0*/
    {0x00,0x00,0x00,0x00,0x3F,0x40,0x00,0x00,0x00,0x00,0x00,0x00},/*"!",1*/
    {0x00,0x00,0x30,0x00,0x40,0x00,0x30,0x00,0x40,0x00,0x00,0x00},/*""",2*/
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    {0x40,0x00,0x80,0x00,0x40,0x00,0x20,0x00,0x20,0x00,0x40,0x00},/*"~",94*/
}; 

const uint8_t Font1608[95][16] PROGMEM = {      
    {0x00,0x00,0x00,0x00,0x00,0x00,0x00,0x00,0x00,0x00,0x00,0x00,0x00,0x00,0x00,0x00},/*" ",0*/
    {0x00,0x00,0x00,0x00,0x00,0x00,0x1F,0xCC,0x00,0x0C,0x00,0x00,0x00,0x00,0x00,0x00},/*"!",1*/
    {0x00,0x00,0x08,0x00,0x30,0x00,0x60,0x00,0x08,0x00,0x30,0x00,0x60,0x00,0x00,0x00},/*""",2*/
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    {0x00,0x00,0x60,0x00,0x80,0x00,0x80,0x00,0x40,0x00,0x40,0x00,0x20,0x00,0x20,0x00},/*"~",94*/
};

const uint8_t Font3216[11][64] PROGMEM = 
{
    {0x00,0x00,0x00,0x00,0x00,0x00,0x00,0x00,0x3F,0xFF,0xFF,0xFC,0x3F,0xFF,0xFF,0xFC,    /*"0",0*/
    0x30,0x00,0x00,0x0C,0x30,0x00,0x00,0x0C,0x30,0x00,0x00,0x0C,0x30,0x00,0x00,0x0C,
    0x30,0x00,0x00,0x0C,0x30,0x00,0x00,0x0C,0x30,0x00,0x00,0x0C,0x30,0x00,0x00,0x0C,
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    0x00,0x00,0x00,0x00,0x00,0x00,0x00,0x00,0x00,0x00,0x00,0x00,0x00,0x00,0x00,0x00}
};    

const uint8_t Signal816[16] PROGMEM = //mobie signal
{
    0xFE,0x02,0x92,0x0A,0x54,0x2A,0x38,0xAA,0x12,0xAA,0x12,0xAA,0x12,0xAA,0x12,0xAA
};

const uint8_t Msg816[16] PROGMEM =  //message
{
    0x1F,0xF8,0x10,0x08,0x18,0x18,0x14,0x28,0x13,0xC8,0x10,0x08,0x10,0x08,0x1F,0xF8
};

const uint8_t Bat816[16] PROGMEM = //batery
{
    0x0F,0xFE,0x30,0x02,0x26,0xDA,0x26,0xDA,0x26,0xDA,0x26,0xDA,0x30,0x02,0x0F,0xFE
};

const uint8_t Bluetooth88[8] PROGMEM = // bluetooth
{
    0x18,0x54,0x32,0x1C,0x1C,0x32,0x54,0x18
};

const uint8_t GPRS88[8] PROGMEM = //GPRS
{
    0xC3,0x99,0x24,0x20,0x2C,0x24,0x99,0xC3
};

const uint8_t Alarm88[8] PROGMEM = //alram
{
    0xC3,0xBD,0x42,0x52,0x4E,0x42,0x3C,0xC3
};


void oled__command(uint8_t cmd) {
  twi_begin(0x3C);
  twi_write(0);
  twi_write(cmd);
  twi_end();
}

void oled__data(uint8_t dat) {
  twi_begin(0x3C);
  twi_write(0x40);
  twi_write(dat);
  twi_end();
}

void oled_init() {
  SET(OLED_RST_PORT, OLED_RST_PIN);
  _delay_ms(10);
  CLEAR(OLED_RST_PORT, OLED_RST_PIN);
  _delay_ms(10);
  SET(OLED_RST_PORT, OLED_RST_PIN);

  oled__command(0xAE);//--turn off oled panel
  oled__command(0x02);//---set low column address
  oled__command(0x10);//---set high column address
  oled__command(0x40);//--set start line address  Set Mapping RAM Display Start Line (0x00~0x3F)
  oled__command(0xA1);//--Set SEG/Column Mapping     
  oled__command(0xC8);//Set COM/Row Scan Direction   
  oled__command(0xA6);//--set normal display
  oled__command(0xA8);//--set multiplex ratio(1 to 64)
  oled__command(0x3F);//--1/64 duty
  oled__command(0xD3);//-set display offset    Shift Mapping RAM Counter (0x00~0x3F)
  oled__command(0x00);//-not offset
  oled__command(0xd5);//--set display clock divide ratio/oscillator frequency
  oled__command(0x80);//--set divide ratio, Set Clock as 100 Frames/Sec
  oled__command(0xAD);//--set charge pump
  oled__command(0x8B);  //set Charge Pump enable
  oled__command(0xDA);//--set com pins hardware configuration
  oled__command(0x12);
  oled__command(0x81);//--set contrast control register
  oled__command(0x80);
  oled__command(0xD9);//--set pre-charge period
  oled__command(0x22);//Set Pre-Charge 
  oled__command(0xDB);//--set vcomh
  oled__command(0x40);//Set VCOM Deselect Level
  oled__command(0x20);//-Set Page Addressing Mode (0x00/0x01/0x02)
  oled__command(0x02);//
  oled__command(0xA4);// Disable Entire Display On (0xa4/0xa5)
  oled__command(0xA6);// Disable Inverse Display On (0xa6/a7) 
  oled__command(0xAF);//--turn on oled panel
  
  return;
}

void oled_on() {
  oled__command(0xAF);
}

void oled_off() {
  oled__command(0xAE);
}

void oled_pixel(int x, int y, char color)
{
    x += 3;  // The first 3 columns are not displayed
    if(x > WIDTH || y > HEIGHT)return ;
    if(color)
        oled_buf[x+(y/8)*WIDTH] |= 1<<(y%8);
    else
        oled_buf[x+(y/8)*WIDTH] &= ~(1<<(y%8));
}

void oled_bitmap(uint8_t x,uint8_t y,const uint8_t *pBmp, uint8_t chWidth, uint8_t chHeight)
{
  uint8_t i, j, byteWidth = (chWidth + 7)/8;
  for(j = 0;j < chHeight;j++){
    for(i = 0;i <chWidth;i++){
      if(pgm_read_byte(pBmp + j * byteWidth + i / 8) & (128 >> (i & 7))){
        oled_pixel(x + i,y + j, 1);
      }
    }
  }   
}

volatile uint8_t dwh_page;
volatile uint8_t dwh_i;
volatile uint8_t dwh_cmds;

void display_write_handler(uint8_t tw_status) {
  if (dwh_i >= WIDTH) {
    dwh_page++;
    dwh_i = 0;
    dwh_cmds = 0;
    twi__start();
    return;
  }
  
  if (dwh_page >= PAGES) {
    twi__stop();
    twi__reset();
    return;
  }

  if (dwh_i == 0) {
    switch (dwh_cmds) {
    case 0:
      twi__send(0);                // command mode
      break;
    case 1:
      twi__send(0xB0 + dwh_page);  // set page address
      break;
    case 2:
      twi__send(0x00);             // set low column address
      break;
    case 3:
      twi__send(0x10);             // set high column address
      break;
    case 4:
      twi__start();
      break;
    default:
      twi__send(0x40);             // data mode
      dwh_i++;
      break;
    }
    dwh_cmds++;
  } else {
    twi__send(oled_buf[dwh_i + dwh_page * WIDTH]);
    dwh_i++;
  }
}


bool oled_display()
{
  if (twi_has_started()) return false;
  dwh_page = 0;
  dwh_i = 0;
  dwh_cmds = 0;
  twi_write_with_delegate(0x3C, display_write_handler);
  return true;
}

void oled_clear()
{
  int i;
  for(i = 0;i < WIDTH * HEIGHT / 8;i++)
  {
    oled_buf[i] = 0;
  }
}

void oled_char1616(uint8_t x, uint8_t y, uint8_t chChar)
{
  uint8_t i, j;
  uint8_t chTemp = 0, y0 = y, chMode = 0;

  for (i = 0; i < 32; i++) {
    chTemp = pgm_read_byte(&Font1612[chChar - 0x30][i]);
    for (j = 0; j < 8; j++) {
      chMode = chTemp & 0x80? 1 : 0; 
      oled_pixel(x, y, chMode);
      chTemp <<= 1;
      y++;
      if ((y - y0) == 16) {
        y = y0;
        x++;
        break;
      }
    }
  }
}

void oled_char(unsigned char x, unsigned char y, char acsii, char size, char mode)
{
    unsigned char i, j, y0=y;
    char temp;
    unsigned char ch = acsii - ' ';
    int loop = (size==32) ? (size*2) : size;
    for(i = 0;i<loop;i++) {
        if(size == 12)
        {
            if(mode)temp = pgm_read_byte(&Font1206[ch][i]);
            else temp = ~pgm_read_byte(&Font1206[ch][i]);
        }
        else if (size == 32)
        {
            if(mode)temp = pgm_read_byte(&Font3216[ch - 0x10][i]);
            else temp = ~pgm_read_byte(&Font3216[ch - 0x10][i]);
        }
        else 
        {            
            if(mode)temp = pgm_read_byte(&Font1608[ch][i]);
            else temp = ~pgm_read_byte(&Font1608[ch][i]);
        }
        for(j =0;j<8;j++)
        {
            if(temp & 0x80) oled_pixel(x, y, 1);
            else oled_pixel(x, y, 0);
            temp <<= 1;
            y++;
            if((y-y0) == size)
            {
                y = y0;
                x++;
                break;
            }
        }
    }
}

void oled_string(uint8_t x, uint8_t y, const char *pString, uint8_t Size, uint8_t Mode)
{
    while (*pString != '\0') {       
        if (x > (WIDTH - Size / 2)) {
            x = 0;
            y += Size;
            if (y > (HEIGHT - Size)) {
                y = x = 0;
            }
        }
        
        oled_char(x, y, *pString, Size, Mode);
        x += Size / 2;
        pString++;
    }
}

void oled_char3216(uint8_t x, uint8_t y, uint8_t chChar)
{
    uint8_t i, j;
    uint8_t chTemp = 0, y0 = y, chMode = 0;

    for (i = 0; i < 64; i++) {
        chTemp = pgm_read_byte(&Font3216[chChar - 0x30][i]);
        for (j = 0; j < 8; j++) {
            chMode = chTemp & 0x80? 1 : 0; 
            oled_pixel(x, y, chMode);
            chTemp <<= 1;
            y++;
            if ((y - y0) == 32) {
                y = y0;
                x++;
                break;
            }
        }
    }
}
